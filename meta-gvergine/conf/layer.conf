## meta-gvergine/conf/layer.conf
```bitbake
# We have a conf and classes directory, append to BBPATH
BBPATH .= ":${LAYERDIR}"

# We have a recipes directory, add to BBFILES
BBFILES += "${LAYERDIR}/recipes*/*/*.bb ${LAYERDIR}/recipes*/*/*.bbappend ${LAYERDIR}/images/*.bb"

BBFILE_COLLECTIONS += "meta-gvergine"
BBFILE_PATTERN_meta-gvergine := "^${LAYERDIR}/"
BBFILE_PRIORITY_meta-gvergine = "16"

LAYERSERIES_COMPAT_meta-gvergine = "dunfell"
```
